## boards/shields/sparta/Kconfig.shield
```kconfig
config SHIELD_SPARTA_LEFT
    def_bool $(shields_list_contains,sparta_left)

config SHIELD_SPARTA_RIGHT
    def_bool $(shields_list_contains,sparta_right)
```
